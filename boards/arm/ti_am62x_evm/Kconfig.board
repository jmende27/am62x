## boards/arm/ti_am62x_evm/Kconfig.board
```kconfig
# TI SimpleLink CC3220SF LaunchXL Board

# SPDX-License-Identifier: Apache-2.0

config BOARD_AM62X_EVM
	bool "TI AM62X EVM"
	depends on SOC_TI_AM62X
```

## boards/arm/ti_am62x_evm/Kconfig.defconfig
```kconfig
# TI CC3220SF LaunchXL board configuration

# SPDX-License-Identifier: Apache-2.0

if BOARD_TI_AM62X_EVM

config BOARD
	default "am62x_evm"

endif # BOARD_AM62X_EVM
```

## boards/arm/ti_am62x_evm/am62x_evm_defconfig
```kconfig
# SPDX-License-Identifier: Apache-2.0

CONFIG_SOC_CC3220SF=y
CONFIG_BOARD_AM62X_EVM=y
CONFIG_BUILD_OUTPUT_HEX=y
CONFIG_CORTEX_M_SYSTICK=y

# enable uart driver
CONFIG_SERIAL=y
CONFIG_UART_CC32XX=y

# enable console
CONFIG_CONSOLE=y
CONFIG_UART_CONSOLE=y
```

## soc/arm/ti_am625/Kconfig
```kconfig
# TI AM62X platform configuration options
# SPDX-License-Identifier: Apache-2.0

config SOC_TI_AM62X
	bool
```
