/* SPDX-License-Identifier: Apache-2.0 */

/dts-v1/;

#include <ti/am62x.dtsi>

/ {
        model = "TI AM62X EVM";
        compatible = "ti,am62x-evm";

        aliases {
                uart-0 = &uart0;
        };

        chosen {
                zephyr,console = &uart0;
                zephyr,shell-uart = &uart0;
		zephyr,flash = &flash0;
		zephyr,sram = &sram0;
        };
};

&uart0 {
	status = "okay";
	current-speed = <115200>;
};
